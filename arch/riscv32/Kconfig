## arch/riscv32/Kconfig
```kconfig
#
# For a description of the syntax of this configuration file,
# see the file kconfig-language.txt in the docs folder of mTower repository.
#

choice
	prompt "MCU Family"
	default FE310

config ARCH_FAMILY_FE310
	bool "FE310"
	---help---
		The FE310 architecture

config ARCH_FAMILY_BL808
	bool "BL808"
	---help---
		The BL808 architecture

config ARCH_FAMILY_ESP32C3
	bool "ESP32-C3"
	---help---
		The Espressif ESP32-C3 architecture

endchoice

config ARCH_FAMILY
	string
	default "fe310"            if ARCH_FAMILY_FE310
	default "bl808"            if ARCH_FAMILY_BL808
	default "esp32c3"          if ARCH_FAMILY_ESP32C3

if ARCH_FAMILY_FE310
comment "FE310 Configuration Options"
source arch/riscv32/fe310/Kconfig
endif

if ARCH_FAMILY_BL808
comment "BL808 Configuration Options"
source arch/riscv32/bl808/Kconfig
endif

if ARCH_FAMILY_ESP32C3
comment "ESP32-C3 Configuration Options"
source arch/riscv32/esp32c3/Kconfig
endif
```

## arch/riscv32/esp32c3/Kconfig
```kconfig
#
# For a description of the syntax of this configuration file,
# see the file kconfig-language.txt in the docs folder of mTower repository.
#

choice
	prompt "ESP32-C3 platform selection"
	default PLATFORM_ESP32C3_SUPERMINI

config PLATFORM_ESP32C3_SUPERMINI
	bool "ESP32-C3 Super Mini board"
	---help---
		ESP32-C3 Super Mini board.

endchoice

config PLATFORM
	string
	default "esp32c3_supermini"  if PLATFORM_ESP32C3_SUPERMINI

if PLATFORM_ESP32C3_SUPERMINI
source arch/riscv32/esp32c3/src/esp32c3_supermini/Kconfig
endif

choice
	prompt "Non-secure debug UART configuration"
	default NONSECURE_DEBUG_UART0

config NONSECURE_DEBUG_UART0
	bool "UART0 / USB-Serial-JTAG"
	---help---
		Console via UART0 or on-chip USB-Serial-JTAG.

endchoice

config NONSECURE_DEBUG_UART
	string
	default "UART0"            if NONSECURE_DEBUG_UART0

choice
	prompt "Non-secure debug font color configuration"
	default NONSECURE_FONT_GREEN

config NONSECURE_FONT_RED
	bool "RED"

config NONSECURE_FONT_GREEN
	bool "GREEN"

config NONSECURE_FONT_YELLOW
	bool "YELLOW"

config NONSECURE_FONT_BLUE
	bool "BLUE"

config NONSECURE_FONT_GRAY
	bool "GRAY"
endchoice

config NONSECURE_FONT_COLOR
	int
	default 1            if NONSECURE_FONT_RED
	default 2            if NONSECURE_FONT_GREEN
	default 3            if NONSECURE_FONT_YELLOW
	default 4            if NONSECURE_FONT_BLUE
	default 7            if NONSECURE_FONT_GRAY
```

## configs/esp32c3_supermini/defconfig
```kconfig
#
# mTower configuration for ESP32-C3 Super Mini
#

#
# Build Setup
#
CONFIG_OPTIMIZATION_LEVEL_OS=y
# CONFIG_OPTIMIZATION_LEVEL_O1 is not set
# CONFIG_OPTIMIZATION_LEVEL_O2 is not set
# CONFIG_OPTIMIZATION_LEVEL_O3 is not set
CONFIG_OPTIMIZATION_LEVEL="-Os"

#
# Debug Options
#
# CONFIG_DEBUG_ALERT is not set
# CONFIG_DEBUG_FEATURES is not set
# CONFIG_DEBUG_SYMBOLS is not set

#
# GP TEE API Debug Options
#
# CONFIG_TRACE_LEVEL_MSG is not set
# CONFIG_TRACE_LEVEL_ERROR is not set
CONFIG_TRACE_LEVEL_INFO=y
# CONFIG_TRACE_LEVEL_DEBUG is not set
# CONFIG_TRACE_LEVEL_FLOW is not set
CONFIG_TRACE_LEVEL=2
# CONFIG_DEBUGLEVEL_ERROR is not set
CONFIG_DEBUGLEVEL_INFO=y
# CONFIG_DEBUGLEVEL_DEBUG is not set
# CONFIG_DEBUGLEVEL_FLOW is not set
CONFIG_DEBUGLEVEL=2

#
# Trusted boot
#
# CONFIG_BOOTLOADER1 is not set
# CONFIG_BOOTLOADER2 is not set
# CONFIG_BOOTLOADER32 is not set
CONFIG_BOOTLOADER33=y
CONFIG_START_ADDRESS_BL32=0x00000000
CONFIG_START_ADDRESS_BL33=0x42000000

#
# System Type
#
# CONFIG_ARCH_CORTEX_M23 is not set
# CONFIG_ARCH_CORTEX_M33 is not set
CONFIG_ARCH_RISCV_32=y
CONFIG_ARCH="riscv32"
CONFIG_ARCH_FAMILY="esp32c3"
CONFIG_PLATFORM="esp32c3_supermini"
# CONFIG_ARCH_FAMILY_FE310 is not set
# CONFIG_ARCH_FAMILY_BL808 is not set
CONFIG_ARCH_FAMILY_ESP32C3=y

#
# ESP32-C3 Configuration Options
#
CONFIG_PLATFORM_ESP32C3_SUPERMINI=y
CONFIG_NONSECURE_DEBUG_UART0=y
CONFIG_NONSECURE_DEBUG_UART="UART0"
CONFIG_NONSECURE_FONT_GREEN=y
CONFIG_NONSECURE_FONT_COLOR=2

#
# Toolchain Configuration Options
#
# CONFIG_GCC_VERSION_6_1_2017Q1 is not set
# CONFIG_GCC_VERSION_6_1_2017Q2 is not set
# CONFIG_GCC_VERSION_8_2018Q4 is not set
# CONFIG_GCC_VERSION_10_2_0_2020_12 is not set
# CONFIG_GCC_VERSION_T_HEAD_10_2_0 is not set
# CONFIG_GCC_VERSION_ESP_RISCV32 is not set
CONFIG_GCC_VERSION_HOST_RISCV64=y
CONFIG_GCC_VERSION="host-riscv64-unknown-elf"
CONFIG_GCC_SITE="none"
CONFIG_GCC_FOLDER="host"

#
# GP TEE Configuration
#
CONFIG_MAX_CRYPTO_CHUNK_SIZE=0x400

#
# Application Configuration
#

#
# Pseudo TAs:
#
CONFIG_APPS_HELLO_WORLD=y

#
# User TAs:
#
# CONFIG_APPS_AES is not set
# CONFIG_APPS_HOTP is not set

#
# Test suite:
#
# CONFIG_APPS_TEST is not set

#
# H/W Security exception:
#
# CONFIG_APPS_HW_SECURITY_EXCEPTION_EXAMPLE is not set
# CONFIG_APPS_SPY is not set
```
